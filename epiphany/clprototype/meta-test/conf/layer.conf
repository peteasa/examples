## epiphany/clprototype/meta-test/conf/layer.conf
```bitbake
# We have a conf and classes directory, add to BBPATH
BBPATH := "${BBPATH}:${LAYERDIR}"

# We have a packages directory, add to BBFILES
BBFILES := "${BBFILES} ${LAYERDIR}/recipes*/*/*.bb"
BBFILES += " ${LAYERDIR}/recipes*/*/*.bbappend"

BBFILE_COLLECTIONS += "clman"
BBFILE_PATTERN_pascom := "^${LAYERDIR}/"
BBFILE_PRIORITY_pascom = "9"
```
